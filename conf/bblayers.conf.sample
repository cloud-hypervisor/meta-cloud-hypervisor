## conf/layer.conf
```bitbake
# We have a conf and classes directory, add to BBPATH
BBPATH .= ":${LAYERDIR}"

# We have recipes-* directories, add to BBFILES
BBFILES += "${LAYERDIR}/recipes-*/*/*.bb \
            ${LAYERDIR}/recipes-*/*/*.bbappend"

BBFILE_COLLECTIONS += "meta-cloud-hypervisor"
BBFILE_PATTERN_meta-cloud-hypervisor = "^${LAYERDIR}/"
BBFILE_PRIORITY_meta-cloud-hypervisor = "8"

#LAYERDEPENDS_meta-cloud-hypervisor = "rust-layer"
LAYERSERIES_COMPAT_meta-cloud-hypervisor = "dunfell gatesgarth hardknott honister"
```
